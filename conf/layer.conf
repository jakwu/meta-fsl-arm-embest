## conf/layer.conf
```bitbake
# We have a conf and classes directory, add to BBPATH
BBPATH .= ":${LAYERDIR}"

# We have a packages directory, add to BBFILES
BBFILES += "${LAYERDIR}/recipes-*/*/*.bb \
            ${LAYERDIR}/recipes-*/*/*.bbappend"

BBFILE_COLLECTIONS += "fsl-arm-marsboard"
BBFILE_PATTERN_fsl-arm-marsboard := "^${LAYERDIR}/"
BBFILE_PRIORITY_fsl-arm-marsboard = "4"

LAYERDEPENDS_fsl-arm-marsboard = "core fsl-arm fsl-arm"
```

## conf/machine/marsboard.conf
```bitbake
#@TYPE: Machine
#@NAME: Embest-Tech i.MX6 MarS Board
#@SOC: i.MX6D
#@DESCRIPTION: Machine configuration for Embest-Tech i.MX6 MarS Board
#@MAINTAINER: Jakob Schwabauer <Jakob.Schwabauer@sartorius.com>

include conf/machine/include/imx-base.inc
include conf/machine/include/tune-cortexa9.inc

SOC_FAMILY = "mx6:mx6q"

KERNEL_DEVICETREE = "imx6q-marsboard.dtb"

PREFERRED_PROVIDER_u-boot = "u-boot-fslc"
PREFERRED_VERSION_u-boot-fslc = "2014.07"
UBOOT_MACHINE = "marsboard_config"

PREFERRED_PROVIDER_virtual/kernel ?= "linux-marsboard"
PREFERRED_VERSION_linux-marsboard ?= "3.10.17"

SERIAL_CONSOLE = "115200 ttymxc1"

MACHINE_FEATURES = ""

IMAGE_FSTYPES = "tar.gz ext3 sdcard"
```
